## main/Kconfig.projbuild
```kconfig
menu "WiFi and MQTT Settings"

    config WIFI_SSID
        string "WiFi SSID"
        default "your_wifi_ssid"

    config WIFI_PASS
        string "WiFi Password"
        default "your_wifi_password"

    config MQTT_BROKER_URI
        string "MQTT Broker URI"
        default "mqtt://<Your-PC-IP-Address>"

    config MQTT_BROKER_PORT
        int "MQTT Broker Port"
        default "1883"

    config MQTT_BROKER_USERNAME
        string "MQTT Broker Username"
        default "username"
        
    config MQTT_BROKER_PASSWORD
        string "MQTT Broker Password"
        default "password"

endmenu
```
